## boards/shields/lily58cirque/Kconfig.defconfig
```kconfig
if SHIELD_LILY58CIRQUE_RIGHT

# Name must be less than 16 characters long!
config ZMK_KEYBOARD_NAME
    default "Lily58Cirque"

config ZMK_SPLIT_ROLE_CENTRAL
    default y

endif

config ZMK_POINTING
    default y

config I2C
    default y

CONFIG_ZMK_POINTING=y
CONFIG_ZMK_INPUT_LISTENER=y
#CONFIG_ZMK_POINTING_SMOOTH_SCROLLING=y

CONFIG_ZMK_RGB_UNDERGLOW=y
# Use the STRIP config specific to the LEDs you're using
CONFIG_WS2812_STRIP=y


if SHIELD_LILY58CIRQUE_LEFT || SHIELD_LILY58CIRQUE_RIGHT

config ZMK_SPLIT
    default y

endif
```
